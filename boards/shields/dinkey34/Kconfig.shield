## boards/shields/dinkey34/Kconfig.shield
```kconfig
# Copyright (c) 2023 Idle Builds
# SPDX-License-Identifier: MIT

config SHIELD_DINKEY34
    bool

config SHIELD_DINKEY34_LEFT
    def_bool $(shields_list_contains,dinkey34_left)
    select SHIELD_DINKEY34

config SHIELD_DINKEY34_RIGHT
    def_bool $(shields_list_contains,dinkey34_right)
    select SHIELD_DINKEY34
```

## config/boards/shields/dinkey34/Kconfig.defconfig
```kconfig
# Copyright (c) 2023 Idle Builds
# SPDX-License-Identifier: MIT

if SHIELD_DINKEY34_LEFT

config ZMK_KEYBOARD_NAME
    default "Dinkey 34"

config ZMK_SPLIT_ROLE_CENTRAL
    default y

endif # SHIELD_DINKEY34_LEFT

if SHIELD_DINKEY34_LEFT || SHIELD_DINKEY34_RIGHT

config ZMK_SPLIT
    default y

endif # SHIELD_DINKEY34_LEFT || SHIELD_DINKEY34_RIGHT
```

## config/boards/shields/dinkey34/Kconfig.shield
```kconfig
# Copyright (c) 2021 The ZMK Contributors
# SPDX-License-Identifier: MIT

config SHIELD_DINKEY34_LEFT
	def_bool $(shields_list_contains,dinkey34_left)

config SHIELD_DINKEY34_RIGHT
	def_bool $(shields_list_contains,dinkey34_right)
```
